/*
 * Copyright (c) 2025 9p4z Contributors
 * SPDX-License-Identifier: Apache-2.0
 */

/ {
	uart_emul0: uart-emul@0 {
		compatible = "zephyr,uart-emul";
		status = "okay";
		loopback;
		latch-buffer-size = <64>;
	};
};
