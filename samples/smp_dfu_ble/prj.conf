## CMakeLists.txt
```
# Copyright (c) 2025 9p4z Contributors
# SPDX-License-Identifier: MIT
#
# The SMP/GATT twin of samples/9p_dfu_l2cap. Same board, same MCUboot, same
# slot layout, same signed image -- the ONLY difference is the DFU mechanism
# above the BLE link. Built to make "GATT or L2CAP?" a measurement, not an
# opinion.

cmake_minimum_required(VERSION 3.20.0)

find_package(Zephyr REQUIRED HINTS $ENV{ZEPHYR_BASE})
project(smp_dfu_ble)

target_sources(app PRIVATE src/main.c)
```

## sysbuild.conf
```
# Sysbuild configuration - enables MCUboot bootloader
# IDENTICAL to samples/9p_dfu_l2cap/sysbuild.conf. Keep it that way: the
# bootloader must not be a variable in the comparison.

SB_CONFIG_BOOTLOADER_MCUBOOT=y
```

## prj.conf
```kconfig
# SMP DFU over BLE GATT - the "traditional" firmware update path
#
# This is the deliberate twin of samples/9p_dfu_l2cap/prj.conf. Diff the two
# files: everything outside the "DFU mechanism" section is held constant, so
# what remains is exactly what each approach costs you.
#
# FAIRNESS NOTE: this is a *tuned* SMP configuration, lifted from Zephyr's own
# samples/subsys/mgmt/mcumgr/smp_svr/overlay-bt.conf -- reassembly on, 2475 B
# netbuf, 498 B ATT MTU, connection-parameter control. An untuned mcumgr build
# would make the comparison a strawman. If SMP loses a number here, it loses it
# configured the way Nordic and the Zephyr project tell you to configure it.

# ========== DFU mechanism: MCUmgr / SMP ==========
# (the 9P twin's counterpart section is NINEP + NINEP_SERVER + NINEP_TRANSPORT_L2CAP
#  + NINEP_DFU + NINEP_GATT_9PIS)
CONFIG_MCUMGR=y
CONFIG_MCUMGR_TRANSPORT_BT=y

# Command groups. Note that DFU needs BOTH: img for the upload/confirm, os for
# the reset. In the 9P twin these are two files (dev/confirm, dev/reboot) in a
# namespace the client discovers by listing it; here they are two separate
# command groups the client must know the CBOR schema of ahead of time.
CONFIG_MCUMGR_GRP_IMG=y
CONFIG_MCUMGR_GRP_OS=y
# Lets the client query the SMP buffer size instead of guessing it. Required in
# practice for reassembly to be usable.
CONFIG_MCUMGR_GRP_OS_MCUMGR_PARAMS=y

# --- SMP-over-GATT throughput tuning (per Zephyr smp_svr/overlay-bt.conf) ---
# GATT gives us no transport-level segmentation, so mcumgr does its own:
# reassemble one SMP packet from five 498-byte Write Commands. The 9P twin needs
# none of this -- an L2CAP CoC SDU is segmented by the controller and paced by
# L2CAP credits, below the application entirely.
CONFIG_MCUMGR_TRANSPORT_BT_REASSEMBLY=y
CONFIG_MCUMGR_TRANSPORT_NETBUF_SIZE=2475
CONFIG_MCUMGR_TRANSPORT_NETBUF_COUNT=6
CONFIG_MCUMGR_TRANSPORT_WORKQUEUE_STACK_SIZE=4608
# Request a fast connection interval while SMP commands are in flight. Depends
# on SYSTEM_WORKQUEUE_PRIORITY < 0 (Zephyr default is -1) and on
# BT_GAP_PERIPHERAL_PREF_PARAMS (default y).
CONFIG_MCUMGR_TRANSPORT_BT_CONN_PARAM_CONTROL=y

# --- SMP service permissions ---
# IMPORTANT, and a real finding for the talk: MCUMGR_TRANSPORT_BT_PERM defaults
# to RW_AUTHEN whenever BT_SMP=y, i.e. the SMP characteristics demand pairing
# AND authentication before a single DFU byte moves. The 9P/L2CAP twin runs its
# CoC at sec_level L1 with no pairing. We force RW here so the two paths are
# measured over the SAME link security -- otherwise we would be timing a
# pairing dance, not a transport. (Deployments SHOULD use the secure default;
# see doc/DFU_COMPARISON.md, "Security posture", where this cuts for SMP.)
CONFIG_MCUMGR_TRANSPORT_BT_PERM_RW=y

# Device-side DFU instrumentation: gives us start/finish events so the board can
# timestamp the transfer itself, independent of host-side connect overhead. The
# 9P twin gets the same via ninep_dfu's status_cb.
CONFIG_MCUMGR_MGMT_NOTIFICATION_HOOKS=y
CONFIG_MCUMGR_GRP_IMG_STATUS_HOOKS=y

# MCUmgr dependencies (9P needs none of these: no CBOR codec, no CRC, no
# separate management buffer pool).
CONFIG_NET_BUF=y
CONFIG_ZCBOR=y
CONFIG_CRC=y

# ========== Bluetooth ==========
# Held constant with the 9P twin except for the two protocol-specific lines
# noted below.
CONFIG_BT=y
CONFIG_BT_PERIPHERAL=y
CONFIG_BT_DEVICE_NAME="SMP DFU"
CONFIG_BT_MAX_CONN=1
CONFIG_BT_GATT_DYNAMIC_DB=y

# Security (matched to the 9P twin)
CONFIG_BT_SMP=y
CONFIG_BT_MAX_PAIRED=3

# BLE buffers - sized for DFU transfers.
# The 9P twin sets ACL RX/TX to 2048 because an L2CAP CoC SDU is reassembled by
# the stack; here the ceiling is the ATT MTU, so 498/502 per Zephyr's own DFU
# overlay is the correct maximum. This asymmetry is not a thumb on the scale --
# it IS the difference being measured.
CONFIG_BT_L2CAP_TX_MTU=498
CONFIG_BT_BUF_ACL_RX_SIZE=502
CONFIG_BT_BUF_ACL_TX_SIZE=502
CONFIG_BT_CTLR_DATA_LENGTH_MAX=251
CONFIG_BT_DATA_LEN_UPDATE=y
CONFIG_BT_AUTO_PHY_UPDATE=y
CONFIG_BT_CTLR_LE_PING=n

# ========== MCUboot / DFU ==========
# IDENTICAL to the 9P twin.
CONFIG_BOOTLOADER_MCUBOOT=y
CONFIG_IMG_MANAGER=y
CONFIG_STREAM_FLASH=y
CONFIG_IMG_ERASE_PROGRESSIVELY=n

# Flash buffer - trades RAM for speed
CONFIG_IMG_BLOCK_BUF_SIZE=512

# ========== Flash ==========
# IDENTICAL to the 9P twin.
CONFIG_FLASH=y
CONFIG_FLASH_MAP=y
CONFIG_FLASH_PAGE_LAYOUT=y
CONFIG_MPU_ALLOW_FLASH_WRITE=y

# ========== Networking (required for net_buf) ==========
CONFIG_NETWORKING=y

# ========== Memory ==========
# IDENTICAL to the 9P twin. mcumgr command handlers want a deeper system
# workqueue than the default; that is a real cost of the mechanism, so it is
# recorded here rather than hidden by raising both twins.
CONFIG_HEAP_MEM_POOL_SIZE=16384
CONFIG_MAIN_STACK_SIZE=2048
CONFIG_SYSTEM_WORKQUEUE_STACK_SIZE=2304

# Reboot support
CONFIG_REBOOT=y

# ========== Logging ==========
# IDENTICAL to the 9P twin.
CONFIG_LOG=y
CONFIG_LOG_MODE_MINIMAL=y

# Console (can disable for production)
CONFIG_CONSOLE=y
CONFIG_UART_CONSOLE=y
```

## sysbuild_thingy91x.conf
```kconfig
# Sysbuild fragment for Thingy:91 X (nRF5340).
#
# Pass with -DSB_CONF_FILE=<this file> (it REPLACES sysbuild.conf, so it must
# also carry the MCUboot line). Identical in both DFU twins.
#
# The nRF5340 is dual-core: the application core's Bluetooth host needs a
# controller on the network core, so sysbuild builds ipc_radio as the HCI
# controller image. Without this there is no radio and neither twin advertises.
SB_CONFIG_BOOTLOADER_MCUBOOT=y
SB_CONFIG_NETCORE_IPC_RADIO=y
SB_CONFIG_NETCORE_IPC_RADIO_BT_HCI_IPC=y
```

## boards/nrf52840dk_nrf52840.conf
```kconfig
# nRF52840 DK specific configuration (identical to the 9P DFU twin)
# 1MB flash, 256KB RAM

# Optimize for size on nRF52840
CONFIG_SIZE_OPTIMIZATIONS=y

# Use internal flash for settings (bonding info)
CONFIG_SETTINGS=y
CONFIG_SETTINGS_RUNTIME=y
CONFIG_BT_SETTINGS=y
CONFIG_FLASH_PAGE_LAYOUT=y
CONFIG_NVS=y
CONFIG_SETTINGS_NVS=y

# nRF52840 has hardware crypto - use it
CONFIG_NORDIC_SECURITY_BACKEND=y
CONFIG_BT_CTLR_LE_ENC=y
```

## boards/thingy91x_nrf5340_cpuapp.conf
```kconfig
# Thingy:91 X — nRF5340 application core.
#
# This file is IDENTICAL in samples/9p_dfu_l2cap and samples/smp_dfu_ble.
# It must stay that way: the board is a control, not a variable.
#
# Console: the board default is already RTT (&rtt0), and we keep it. Do NOT
# move the console to uart0 — on a Thingy:91 X the 5340's uart0 is the
# inter-chip link to the nRF9151, so console traffic would be shouted at the
# other MCU. RTT also keeps the USB device stack out of both images, so the
# flash/RAM delta between the twins is the DFU mechanism and nothing else.
CONFIG_UART_CONSOLE=n
CONFIG_RTT_CONSOLE=y
CONFIG_USE_SEGGER_RTT=y

# Match the other boards' optimization level so code-size numbers are comparable.
CONFIG_SIZE_OPTIMIZATIONS=y
```

## src/main.c
```c
/*
 * Copyright (c) 2025 9p4z Contributors
 * SPDX-License-Identifier: MIT
 *
 * Minimal SMP DFU Server over Bluetooth GATT — the "traditional" firmware
 * update path, and the deliberate twin of samples/9p_dfu_l2cap.
 *
 * Same board, same MCUboot, same slot layout, same signed image. The only
 * variable is the DFU mechanism above the BLE link:
 *
 *   9p_dfu_l2cap : 9P2000 over an L2CAP CoC       -> write a file
 *   smp_dfu_ble  : SMP/CBOR over GATT (MCUmgr)    -> img upload, img confirm, os reset
 *
 * Read this file next to samples/9p_dfu_l2cap/src/main.c. The difference in
 * what the *application* has to say is small; the difference in what the
 * *client* has to know is not. See doc/DFU_COMPARISON.md.
 */

#include <stdint.h>
#include <zephyr/kernel.h>
#include <zephyr/logging/log.h>
#include <zephyr/bluetooth/bluetooth.h>
#include <zephyr/bluetooth/conn.h>
#include <zephyr/dfu/mcuboot.h>

#include <zephyr/mgmt/mcumgr/mgmt/callbacks.h>
#include <zephyr/mgmt/mcumgr/grp/img_mgmt/img_mgmt.h>
#include <zephyr/mgmt/mcumgr/grp/img_mgmt/img_mgmt_callbacks.h>

LOG_MODULE_REGISTER(main, LOG_LEVEL_INF);

/*
 * Bluetooth advertising data.
 *
 * The 9P twin advertises the 9PIS service UUID, whose characteristics tell a
 * client the PSM and MTU to use — i.e. the transport is self-describing. Here
 * we advertise the SMP service UUID (8D53DC1D-1DB7-4CD3-868B-8A527460AA84,
 * little-endian) which is a bare "I speak SMP" flag: the client is expected to
 * already know the protocol, the command groups and the CBOR schemas.
 */
static const struct bt_data ad[] = {
	BT_DATA_BYTES(BT_DATA_FLAGS, (BT_LE_AD_GENERAL | BT_LE_AD_NO_BREDR)),
	BT_DATA_BYTES(BT_DATA_UUID128_ALL,
		0x84, 0xaa, 0x60, 0x74, 0x52, 0x8a, 0x8b, 0x86,
		0xd3, 0x4c, 0xb7, 0x1d, 0x1d, 0xdc, 0x53, 0x8d),
};

static const struct bt_data sd[] = {
	BT_DATA(BT_DATA_NAME_COMPLETE, CONFIG_BT_DEVICE_NAME,
	        sizeof(CONFIG_BT_DEVICE_NAME) - 1),
};

/* ------------------------------------------------------------------------ */
/* Device-side transfer instrumentation                                      */
/*                                                                           */
/* Emits the same BENCH lines as the 9P twin so the two can be timed by the  */
/* board itself, with no host-side connect/scan overhead in the number.      */
/* ------------------------------------------------------------------------ */

static int64_t bench_start_ms;
static size_t bench_last_off;
static size_t bench_total;

static void bench_begin(void)
{
	bench_start_ms = k_uptime_get();
	bench_last_off = 0;
	bench_total = 0;
	printk("BENCH mech=smp-gatt event=start\n");
}

static void bench_end(const char *how)
{
	int64_t dt = k_uptime_get() - bench_start_ms;

	if (bench_start_ms == 0) {
		return;
	}
	if (dt <= 0) {
		dt = 1;
	}
	printk("BENCH mech=smp-gatt event=%s bytes=%u ms=%lld Bps=%lld\n",
	       how, (unsigned int)bench_total, dt,
	       ((int64_t)bench_total * 1000) / dt);
	bench_start_ms = 0;
}

/* Connection callbacks */
static void connected(struct bt_conn *conn, uint8_t err)
{
	if (err) {
		LOG_ERR("Connection failed (err %u)", err);
		return;
	}
	LOG_INF("Connected");
}

static void disconnected(struct bt_conn *conn, uint8_t reason)
{
	LOG_INF("Disconnected (reason %u)", reason);

	/* Restart advertising */
	int ret = bt_le_adv_start(BT_LE_ADV_PARAM(BT_LE_ADV_OPT_CONN,
	                                           BT_GAP_ADV_FAST_INT_MIN_2,
	                                           BT_GAP_ADV_FAST_INT_MAX_2, NULL),
	                          ad, ARRAY_SIZE(ad), sd, ARRAY_SIZE(sd));
	if (ret) {
		LOG_ERR("Failed to restart advertising: %d", ret);
	}
}

BT_CONN_CB_DEFINE(conn_callbacks) = {
	.connected = connected,
	.disconnected = disconnected,
};

/*
 * MCUmgr DFU notification hook — the SMP counterpart of the 9P twin's
 * ninep_dfu status_cb. Note that where the 9P side gets a byte count handed to
 * it by the DFU module, here we have to reconstruct progress from the offset
 * carried in each upload request.
 */
static enum mgmt_cb_return dfu_hook(uint32_t event, enum mgmt_cb_return prev_status,
                                    int32_t *rc, uint16_t *group, bool *abort_more,
                                    void *data, size_t data_size)
{
	switch (event) {
	case MGMT_EVT_OP_IMG_MGMT_DFU_STARTED:
		LOG_INF("DFU: upload started");
		bench_begin();
		break;

	case MGMT_EVT_OP_IMG_MGMT_DFU_CHUNK: {
		const struct img_mgmt_upload_check *check = data;

		if (data != NULL && data_size >= sizeof(*check) &&
		    check->req != NULL) {
			size_t off = check->req->off;

			if (off != SIZE_MAX && off >= bench_last_off) {
				bench_total = off + check->req->img_data.len;
				bench_last_off = off;
			}
		}
		break;
	}

	case MGMT_EVT_OP_IMG_MGMT_DFU_PENDING:
		LOG_INF("DFU: complete! Confirm and reset to apply.");
		bench_end("complete");
		break;

	case MGMT_EVT_OP_IMG_MGMT_DFU_STOPPED:
		LOG_ERR("DFU: stopped/aborted");
		bench_end("aborted");
		break;

	default:
		break;
	}

	return MGMT_CB_OK;
}

static struct mgmt_callback dfu_callbacks = {
	.callback = dfu_hook,
	.event_id = (MGMT_EVT_OP_IMG_MGMT_DFU_STARTED |
	             MGMT_EVT_OP_IMG_MGMT_DFU_CHUNK |
	             MGMT_EVT_OP_IMG_MGMT_DFU_PENDING |
	             MGMT_EVT_OP_IMG_MGMT_DFU_STOPPED),
};

int main(void)
{
	int ret;

	LOG_INF("SMP DFU Server starting...");

	/* Check if we need to confirm the running image.
	 * The 9P twin points you at a file to write (/dev/confirm). Here the
	 * equivalent is the `img confirm` mcumgr command — there is no
	 * namespace to discover it from.
	 */
	if (!boot_is_img_confirmed()) {
		LOG_WRN("Image not confirmed - will revert on next reboot!");
		LOG_WRN("Send `mcumgr image confirm <hash>` to make permanent");
	}

	mgmt_callback_register(&dfu_callbacks);

	/* Initialize Bluetooth. The SMP GATT service registers itself at boot
	 * (MCUMGR_TRANSPORT_BT_DYNAMIC_SVC_REGISTRATION, default y), so unlike
	 * the 9P twin there is no server/transport to bring up here.
	 */
	ret = bt_enable(NULL);
	if (ret < 0) {
		LOG_ERR("Bluetooth init failed: %d", ret);
		return ret;
	}
	LOG_INF("Bluetooth initialized");

	ret = bt_le_adv_start(BT_LE_ADV_PARAM(BT_LE_ADV_OPT_CONN,
	                                       BT_GAP_ADV_FAST_INT_MIN_2,
	                                       BT_GAP_ADV_FAST_INT_MAX_2, NULL),
	                      ad, ARRAY_SIZE(ad), sd, ARRAY_SIZE(sd));
	if (ret < 0) {
		LOG_ERR("Advertising failed to start: %d", ret);
		return ret;
	}

	LOG_INF("SMP DFU server advertising as '%s'", CONFIG_BT_DEVICE_NAME);
	LOG_INF("Upload: mcumgr image upload / smpmgr upload");

	return 0;
}
```
