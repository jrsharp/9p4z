## CMakeLists.txt
```
# Copyright (c) 2025 9p4z Contributors
# SPDX-License-Identifier: MIT

cmake_minimum_required(VERSION 3.20.0)

find_package(Zephyr REQUIRED HINTS $ENV{ZEPHYR_BASE})
project(9p_dfu_l2cap)

target_sources(app PRIVATE src/main.c)
```

## sysbuild.conf
```
# Sysbuild configuration - enables MCUboot bootloader

SB_CONFIG_BOOTLOADER_MCUBOOT=y
```

## prj.conf
```kconfig
# 9P DFU over L2CAP - Minimal Configuration
# Suitable for ZMK keyboards and other BLE devices

# ========== 9P Protocol ==========
CONFIG_NINEP=y
CONFIG_NINEP_SERVER=y
CONFIG_NINEP_CLIENT=n
CONFIG_NINEP_TRANSPORT_L2CAP=y
CONFIG_NINEP_DFU=y
CONFIG_NINEP_GATT_9PIS=y

# Keep message size reasonable for BLE
CONFIG_NINEP_MAX_MESSAGE_SIZE=4096
CONFIG_NINEP_MAX_FIDS=16
CONFIG_NINEP_MAX_TAGS=8

# L2CAP settings - use compliant PSM
CONFIG_NINEP_L2CAP_PSM=0x0080
CONFIG_NINEP_L2CAP_MTU=2048

# ========== Bluetooth ==========
CONFIG_BT=y
CONFIG_BT_PERIPHERAL=y
CONFIG_BT_DEVICE_NAME="9P DFU"
CONFIG_BT_MAX_CONN=1
CONFIG_BT_L2CAP_DYNAMIC_CHANNEL=y
CONFIG_BT_GATT_DYNAMIC_DB=y

# Security (optional but recommended)
CONFIG_BT_SMP=y
CONFIG_BT_MAX_PAIRED=3

# BLE buffers + link budget - sized for DFU transfers.
#
# IMPORTANT: CONFIG_BT_L2CAP_TX_MTU must be raised explicitly. Its default is
# 65 bytes, and NINEP_L2CAP_MTU does NOT change it -- that only sets 9p4z's own
# ceiling. Left at the default this sample ran a 65-byte L2CAP MTU while
# allocating 2 KB ACL buffers it could never fill: slow AND wasteful. (Found by
# diffing the built .config against the SMP twin; see doc/DFU_COMPARISON.md.)
#
# These values are deliberately IDENTICAL to samples/smp_dfu_ble so both twins
# run over the same link layer and the only variable left is the protocol.
CONFIG_BT_L2CAP_TX_MTU=498
CONFIG_BT_BUF_ACL_RX_SIZE=502
CONFIG_BT_BUF_ACL_TX_SIZE=502
CONFIG_BT_CTLR_DATA_LENGTH_MAX=251
CONFIG_BT_DATA_LEN_UPDATE=y
CONFIG_BT_AUTO_PHY_UPDATE=y
CONFIG_BT_CTLR_LE_PING=n

# ========== MCUboot / DFU ==========
CONFIG_BOOTLOADER_MCUBOOT=y
CONFIG_IMG_MANAGER=y
CONFIG_STREAM_FLASH=y
CONFIG_IMG_ERASE_PROGRESSIVELY=n

# Flash buffer - trades RAM for speed
CONFIG_IMG_BLOCK_BUF_SIZE=512

# ========== Flash ==========
CONFIG_FLASH=y
CONFIG_FLASH_MAP=y
CONFIG_FLASH_PAGE_LAYOUT=y
CONFIG_MPU_ALLOW_FLASH_WRITE=y

# ========== Networking (required for net_buf) ==========
CONFIG_NETWORKING=y

# ========== Memory ==========
# Minimal heap - DFU pre-erases so doesn't need progressive erase heap
CONFIG_HEAP_MEM_POOL_SIZE=16384
CONFIG_MAIN_STACK_SIZE=2048

# Reboot support
CONFIG_REBOOT=y

# ========== Logging ==========
CONFIG_LOG=y
CONFIG_LOG_MODE_MINIMAL=y
CONFIG_NINEP_LOG_LEVEL_INF=y

# Console (can disable for production)
CONFIG_CONSOLE=y
CONFIG_UART_CONSOLE=y
```

## boards/nrf52840dk_nrf52840.conf
```kconfig
# nRF52840 DK specific configuration
# 1MB flash, 256KB RAM

# Optimize for size on nRF52840
CONFIG_SIZE_OPTIMIZATIONS=y

# Use internal flash for settings (bonding info)
CONFIG_SETTINGS=y
CONFIG_SETTINGS_RUNTIME=y
CONFIG_BT_SETTINGS=y
CONFIG_FLASH_PAGE_LAYOUT=y
CONFIG_NVS=y
CONFIG_SETTINGS_NVS=y

# nRF52840 has hardware crypto - use it
CONFIG_NORDIC_SECURITY_BACKEND=y
CONFIG_BT_CTLR_LE_ENC=y
```

## boards/nrf52840dongle_nrf52840.conf
```kconfig
# nRF52840 Dongle specific configuration
# Uses Nordic Open Bootloader, NOT MCUboot

# Disable MCUboot - dongle uses Nordic Open Bootloader
CONFIG_BOOTLOADER_MCUBOOT=n

# Optimize for size
CONFIG_SIZE_OPTIMIZATIONS=y

# USB CDC for console (dongle has no UART pins exposed)
CONFIG_USB_DEVICE_STACK=y
CONFIG_USB_CDC_ACM=y
CONFIG_UART_LINE_CTRL=y

# Use USB CDC as console
CONFIG_UART_CONSOLE=n
CONFIG_USB_CDC_ACM_LOG_LEVEL_OFF=y
CONFIG_LOG_BACKEND_UART=y

# Settings storage
CONFIG_SETTINGS=y
CONFIG_SETTINGS_RUNTIME=y
CONFIG_BT_SETTINGS=y
CONFIG_NVS=y
CONFIG_SETTINGS_NVS=y

# nRF52840 has hardware crypto
CONFIG_NORDIC_SECURITY_BACKEND=y
```

## src/main.c
```c
/*
 * Copyright (c) 2025 9p4z Contributors
 * SPDX-License-Identifier: MIT
 *
 * Minimal 9P DFU Server over Bluetooth L2CAP
 *
 * Provides firmware update capability via 9P filesystem.
 * Exposes /dev/firmware for MCUboot image uploads.
 */

#include <zephyr/kernel.h>
#include <zephyr/logging/log.h>
#include <zephyr/sys/reboot.h>
#include <zephyr/bluetooth/bluetooth.h>
#include <zephyr/bluetooth/conn.h>
#include <zephyr/dfu/mcuboot.h>

#include <zephyr/9p/server.h>
#include <zephyr/9p/session_pool_l2cap.h>
#include <zephyr/9p/sysfs.h>
#include <zephyr/9p/dfu.h>

#ifdef CONFIG_NINEP_GATT_9PIS
#include <zephyr/9p/gatt_9pis.h>
#endif

LOG_MODULE_REGISTER(main, LOG_LEVEL_INF);

/* 9P server: an L2CAP session pool.
 *
 * NOTE: this sample previously used the single-session ninep_transport_l2cap
 * API, which no longer links. 9p4z's CMakeLists compiles session_pool_l2cap.c
 * INSTEAD OF transport_l2cap.c whenever CONFIG_NINEP_SERVER=y (the pool is the
 * "preferred path" for servers), so ninep_transport_l2cap_init was simply never
 * built into the library and the sample failed at link with
 * "undefined reference to ninep_transport_l2cap_init".
 *
 * The pool is also what dect_relay uses in production, so this keeps the DFU
 * comparison measuring the real path rather than a deprecated one. */
NINEP_SESSION_POOL_L2CAP_DEFINE(l2cap_pool, 1, CONFIG_NINEP_MAX_MESSAGE_SIZE);

/* Sysfs for virtual files */
static struct ninep_sysfs sysfs;
static struct ninep_sysfs_entry sysfs_entries[8];

/* DFU instance */
static struct ninep_dfu dfu;

/* Bluetooth advertising data - include 9PIS service UUID for discoverability */
static const struct bt_data ad[] = {
	BT_DATA_BYTES(BT_DATA_FLAGS, (BT_LE_AD_GENERAL | BT_LE_AD_NO_BREDR)),
#ifdef CONFIG_NINEP_GATT_9PIS
	/* Advertise 9PIS service UUID so iOS can filter for 9P devices */
	BT_DATA_BYTES(BT_DATA_UUID128_ALL,
		0x01, 0xc0, 0xe4, 0xf6, 0xe0, 0xa1, 0x88, 0xba,
		0x91, 0x4a, 0xed, 0xfe, 0x01, 0x00, 0x50, 0x39),  /* 39500001-feed-4a91-ba88-a1e0f6e4c001 */
#endif
};

static const struct bt_data sd[] = {
	BT_DATA(BT_DATA_NAME_COMPLETE, CONFIG_BT_DEVICE_NAME,
	        sizeof(CONFIG_BT_DEVICE_NAME) - 1),
};

/* Connection callbacks */
static void connected(struct bt_conn *conn, uint8_t err)
{
	if (err) {
		LOG_ERR("Connection failed (err %u)", err);
		return;
	}
	LOG_INF("Connected");
}

static void disconnected(struct bt_conn *conn, uint8_t reason)
{
	LOG_INF("Disconnected (reason %u)", reason);

	/* Restart advertising */
	int ret = bt_le_adv_start(BT_LE_ADV_PARAM(BT_LE_ADV_OPT_CONN,
	                                           BT_GAP_ADV_FAST_INT_MIN_2,
	                                           BT_GAP_ADV_FAST_INT_MAX_2, NULL),
	                          ad, ARRAY_SIZE(ad), sd, ARRAY_SIZE(sd));
	if (ret) {
		LOG_ERR("Failed to restart advertising: %d", ret);
	}
}

BT_CONN_CB_DEFINE(conn_callbacks) = {
	.connected = connected,
	.disconnected = disconnected,
};

/* Sysfs: device name */
static int gen_name(uint8_t *buf, size_t buf_size, uint64_t offset, void *ctx)
{
	const char *name = CONFIG_BT_DEVICE_NAME "\n";
	size_t len = strlen(name);

	if (offset >= len) {
		return 0;
	}
	size_t to_copy = MIN(len - offset, buf_size);
	memcpy(buf, name + offset, to_copy);
	return to_copy;
}

/* Sysfs: reboot command */
static int write_reboot(const uint8_t *buf, uint32_t count, uint64_t offset, void *ctx)
{
	LOG_INF("Reboot requested via 9P");
	k_sleep(K_MSEC(100)); /* Let logs flush */
	sys_reboot(SYS_REBOOT_COLD);
	return count; /* Never reached */
}

/* Sysfs: confirm image */
static int write_confirm(const uint8_t *buf, uint32_t count, uint64_t offset, void *ctx)
{
	int ret = ninep_dfu_confirm();
	if (ret == 0) {
		LOG_INF("Image confirmed via 9P");
	}
	return ret < 0 ? ret : count;
}

/* ------------------------------------------------------------------------ */
/* Device-side transfer instrumentation                                      */
/*                                                                           */
/* Emits the same BENCH lines as the SMP twin (samples/smp_dfu_ble) so the    */
/* two can be timed by the board itself, with no host-side scan/connect       */
/* overhead in the number. The clock starts when the first upload byte is     */
/* accepted (which is also when the secondary slot erase begins, since        */
/* IMG_ERASE_PROGRESSIVELY=n in both twins) and stops at COMPLETE.            */
/* ------------------------------------------------------------------------ */

static int64_t bench_start_ms;

static void bench_begin(void)
{
	bench_start_ms = k_uptime_get();
	printk("BENCH mech=9p-l2cap event=start\n");
}

static void bench_end(const char *how, uint32_t bytes)
{
	int64_t dt = k_uptime_get() - bench_start_ms;

	if (bench_start_ms == 0) {
		return;
	}
	if (dt <= 0) {
		dt = 1;
	}
	printk("BENCH mech=9p-l2cap event=%s bytes=%u ms=%lld Bps=%lld\n",
	       how, (unsigned int)bytes, dt, ((int64_t)bytes * 1000) / dt);
	bench_start_ms = 0;
}

/* DFU status callback (optional) */
static void dfu_status(enum ninep_dfu_state state, uint32_t bytes, int err)
{
	switch (state) {
	case NINEP_DFU_ERASING:
		LOG_INF("DFU: erasing flash...");
		bench_begin();
		break;
	case NINEP_DFU_RECEIVING:
		/* Progress logged by DFU module */
		break;
	case NINEP_DFU_COMPLETE:
		LOG_INF("DFU: complete! Reboot to apply.");
		bench_end("complete", bytes);
		break;
	case NINEP_DFU_ERROR:
		LOG_ERR("DFU: error %d", err);
		bench_end("aborted", bytes);
		break;
	default:
		break;
	}
}

/* Initialize sysfs with system files */
static int init_sysfs(void)
{
	int ret;

	ret = ninep_sysfs_init(&sysfs, sysfs_entries, ARRAY_SIZE(sysfs_entries));
	if (ret < 0) {
		LOG_ERR("Failed to init sysfs: %d", ret);
		return ret;
	}

	/* /name - device name */
	ret = ninep_sysfs_register_file(&sysfs, "name", gen_name, NULL);
	if (ret < 0) {
		LOG_ERR("Failed to register /name: %d", ret);
		return ret;
	}

	/* /dev/reboot - write to reboot */
	ret = ninep_sysfs_register_writable_file(&sysfs, "dev/reboot",
	                                          NULL, write_reboot, NULL);
	if (ret < 0) {
		LOG_ERR("Failed to register /dev/reboot: %d", ret);
		return ret;
	}

	/* /dev/confirm - write to confirm image */
	ret = ninep_sysfs_register_writable_file(&sysfs, "dev/confirm",
	                                          NULL, write_confirm, NULL);
	if (ret < 0) {
		LOG_ERR("Failed to register /dev/confirm: %d", ret);
		return ret;
	}

	/* /dev/firmware - DFU endpoint */
	struct ninep_dfu_config dfu_cfg = {
		.path = "dev/firmware",
		.status_cb = dfu_status,
	};
	ret = ninep_dfu_init(&dfu, &sysfs, &dfu_cfg);
	if (ret < 0) {
		LOG_ERR("Failed to init DFU: %d", ret);
		return ret;
	}

	LOG_INF("Sysfs initialized");
	return 0;
}

/* Initialize 9P server */
static int init_9p_server(void)
{
	int ret;

	/* One session is enough for DFU, and matches the SMP twin's
	 * CONFIG_BT_MAX_CONN=1 so the two are comparable. */
	struct ninep_session_pool_l2cap_config l2cap_config = {
		.psm = CONFIG_NINEP_L2CAP_PSM,
		.max_sessions = 1,
		.rx_buf_size_per_session = CONFIG_NINEP_MAX_MESSAGE_SIZE,
		.fs_ops = ninep_sysfs_get_ops(),
		.fs_context = &sysfs,
	};

	ret = ninep_session_pool_l2cap_init(&l2cap_pool, &l2cap_config);
	if (ret < 0) {
		LOG_ERR("Failed to init L2CAP session pool: %d", ret);
		return ret;
	}

	/* Registers the L2CAP PSM and starts listening. */
	ret = ninep_session_pool_l2cap_start(&l2cap_pool);
	if (ret < 0) {
		LOG_ERR("Failed to start 9P server: %d", ret);
		return ret;
	}

	LOG_INF("9P server listening on L2CAP PSM 0x%04x", CONFIG_NINEP_L2CAP_PSM);
	return 0;
}

int main(void)
{
	int ret;

	LOG_INF("9P DFU Server starting...");

	/* Check if we need to confirm the running image */
	if (!boot_is_img_confirmed()) {
		LOG_WRN("Image not confirmed - will revert on next reboot!");
		LOG_WRN("Write to /dev/confirm to make permanent");
	}

	/* Initialize Bluetooth */
	ret = bt_enable(NULL);
	if (ret < 0) {
		LOG_ERR("Bluetooth init failed: %d", ret);
		return ret;
	}
	LOG_INF("Bluetooth initialized");

	/* Initialize sysfs (including DFU) */
	ret = init_sysfs();
	if (ret < 0) {
		return ret;
	}

	/* Initialize 9P server */
	ret = init_9p_server();
	if (ret < 0) {
		return ret;
	}

#ifdef CONFIG_NINEP_GATT_9PIS
	/* Register 9PIS GATT service for discovery */
	char transport_info[32];
	snprintf(transport_info, sizeof(transport_info),
	         "l2cap:psm=0x%04x", CONFIG_NINEP_L2CAP_PSM);

	struct ninep_9pis_config gatt_config = {
		.service_description = "9P DFU Server",
		.service_features = "dfu,firmware-update",
		.transport_info = transport_info,
		.protocol_version = "9P2000",
	};
	ret = ninep_9pis_init(&gatt_config);
	if (ret < 0) {
		LOG_WRN("Failed to register 9PIS GATT: %d", ret);
	}
#endif

	/* Start advertising */
	ret = bt_le_adv_start(BT_LE_ADV_PARAM(BT_LE_ADV_OPT_CONN,
	                                       BT_GAP_ADV_FAST_INT_MIN_2,
	                                       BT_GAP_ADV_FAST_INT_MAX_2, NULL),
	                      ad, ARRAY_SIZE(ad), sd, ARRAY_SIZE(sd));
	if (ret < 0) {
		LOG_ERR("Advertising failed to start: %d", ret);
		return ret;
	}
	LOG_INF("Advertising started");

	LOG_INF("Ready! Files: /dev/firmware, /dev/reboot, /dev/confirm, /name");

	/* Server runs via L2CAP callbacks - just idle here */
	while (1) {
		k_sleep(K_SECONDS(60));
	}

	return 0;
}
```
