## CMakeLists.txt
```
# Copyright (c) 2025 9p4z Contributors
# SPDX-License-Identifier: MIT

cmake_minimum_required(VERSION 3.20.0)

find_package(Zephyr REQUIRED HINTS $ENV{ZEPHYR_BASE})
project(9p_server_all_transports)

target_sources(app PRIVATE src/main.c)
```

## prj.conf
```kconfig
# 9P All Transports Server Sample Configuration

# Enable 9P support with all transports
CONFIG_NINEP=y
CONFIG_NINEP_CLIENT=n
CONFIG_NINEP_SERVER=y
CONFIG_NINEP_TRANSPORT_UART=y
CONFIG_NINEP_TRANSPORT_TCP=y
CONFIG_NINEP_TRANSPORT_L2CAP=y

# Message and resource limits
CONFIG_NINEP_MAX_MESSAGE_SIZE=8192
CONFIG_NINEP_MAX_FIDS=64
CONFIG_NINEP_MAX_TAGS=32

# L2CAP transport settings
CONFIG_NINEP_L2CAP_PSM=0x0009
CONFIG_NINEP_L2CAP_MTU=4096

# Logging and console
CONFIG_LOG=y
CONFIG_NINEP_LOG_LEVEL_DBG=y
CONFIG_CONSOLE=y
CONFIG_UART_CONSOLE=y

# Heap for dynamic allocation
CONFIG_HEAP_MEM_POOL_SIZE=65536

# Networking (for TCP transport)
CONFIG_NETWORKING=y
CONFIG_NET_IPV4=y
CONFIG_NET_TCP=y
CONFIG_NET_SOCKETS=y

# Network stack sizing
CONFIG_NET_PKT_RX_COUNT=16
CONFIG_NET_PKT_TX_COUNT=16
CONFIG_NET_BUF_RX_COUNT=16
CONFIG_NET_BUF_TX_COUNT=16
CONFIG_NET_CONTEXT_NET_PKT_POOL=y

# DHCP for dynamic IP addressing
CONFIG_NET_DHCPV4=y
CONFIG_NET_CONFIG_SETTINGS=y
CONFIG_NET_CONFIG_NEED_IPV4=y

# Bluetooth (for L2CAP transport)
CONFIG_BT=y
CONFIG_BT_PERIPHERAL=y
CONFIG_BT_DEVICE_NAME="9P All Transports"
CONFIG_BT_L2CAP_DYNAMIC_CHANNEL=y

# BT settings for better performance
CONFIG_BT_BUF_ACL_RX_SIZE=4096
CONFIG_BT_BUF_ACL_TX_SIZE=4096
CONFIG_BT_CTLR_DATA_LENGTH_MAX=251

# BT logging
CONFIG_BT_DEBUG_LOG=y

# Shell for runtime control
CONFIG_SHELL=y
CONFIG_SHELL_BACKEND_SERIAL=y
CONFIG_BT_SHELL=y
CONFIG_NET_SHELL=y

# UART settings (for UART transport)
CONFIG_SERIAL=y
CONFIG_UART_INTERRUPT_DRIVEN=y
```

## prj_nrf.conf
```kconfig
# 9P All Transports Server Sample Configuration for nRF7002dk
# Use: west build -b nrf7002dk/nrf5340/cpuapp -DCONF_FILE=prj_nrf.conf

# Enable 9P support with all transports
CONFIG_NINEP=y
CONFIG_NINEP_CLIENT=n
CONFIG_NINEP_SERVER=y
CONFIG_NINEP_TRANSPORT_UART=y
CONFIG_NINEP_TRANSPORT_TCP=y
CONFIG_NINEP_TRANSPORT_L2CAP=y

# Message and resource limits (increased for 3 servers)
CONFIG_NINEP_MAX_MESSAGE_SIZE=8192
CONFIG_NINEP_MAX_FIDS=64
CONFIG_NINEP_MAX_TAGS=32

# L2CAP transport settings
CONFIG_NINEP_L2CAP_PSM=0x0009
CONFIG_NINEP_L2CAP_MTU=4096

# Logging and console
CONFIG_LOG=y
CONFIG_NINEP_LOG_LEVEL_DBG=y
CONFIG_CONSOLE=y
CONFIG_UART_CONSOLE=y
CONFIG_PRINTK=y
CONFIG_EARLY_CONSOLE=y

# Shell for runtime control (WiFi + Bluetooth)
CONFIG_SHELL=y
CONFIG_SHELL_BACKEND_SERIAL=y
CONFIG_SHELL_STACK_SIZE=5400
CONFIG_NET_SHELL=y
CONFIG_BT_SHELL=y
CONFIG_DNS_RESOLVER=y

# Heap for dynamic allocation (WiFi heaps are board-specific)
CONFIG_HEAP_MEM_POOL_SIZE=65536

# Stack sizes for network threads
CONFIG_MAIN_STACK_SIZE=5200
CONFIG_NET_TX_STACK_SIZE=4096
CONFIG_NET_RX_STACK_SIZE=4096

# Networking (for TCP transport)
CONFIG_NETWORKING=y
CONFIG_NET_L2_ETHERNET=y
CONFIG_NET_IPV4=y
CONFIG_NET_TCP=y
CONFIG_NET_SOCKETS=y
CONFIG_NET_LOG=y

# WiFi support (board-specific config in boards/*.conf)
CONFIG_WIFI_NM_WPA_SUPPLICANT=y
CONFIG_NRF_WIFI_LOW_POWER=n

# Network stack sizing (tuned for WiFi)
CONFIG_NET_PKT_RX_COUNT=60
CONFIG_NET_PKT_TX_COUNT=6
CONFIG_NET_BUF_RX_COUNT=60
CONFIG_NET_BUF_TX_COUNT=12
CONFIG_NET_CONTEXT_NET_PKT_POOL=y
CONFIG_NET_TC_TX_COUNT=1

# IP addressing - use DHCP
CONFIG_NET_CONFIG_SETTINGS=y
CONFIG_NET_CONFIG_NEED_IPV4=y
CONFIG_NET_DHCPV4=y
CONFIG_NET_CONFIG_MY_IPV4_ADDR=""
CONFIG_NET_CONFIG_MY_IPV4_NETMASK=""

# Bluetooth (for L2CAP transport - base config in boards/*.conf)
CONFIG_BT_DEVICE_NAME="THE_GRID"
CONFIG_BT_L2CAP_DYNAMIC_CHANNEL=y

# BT buffer configuration
CONFIG_BT_BUF_ACL_RX_SIZE=4096
CONFIG_BT_BUF_ACL_TX_SIZE=4096
CONFIG_BT_BUF_ACL_TX_COUNT=8
CONFIG_BT_BUF_EVT_RX_COUNT=16

# BT logging (BT_DEBUG_LOG is deprecated in NCS)
CONFIG_BT_LOG_LEVEL_DBG=y

# UART settings (for UART transport)
CONFIG_SERIAL=y
CONFIG_UART_INTERRUPT_DRIVEN=y

# Build output for flashing
CONFIG_BUILD_OUTPUT_HEX=y

# Note: WiFi credentials persistence disabled to avoid partition conflicts
# Use shell to connect: wifi connect -s "SSID" -k 3 -p "password"
```

## boards/nrf7002dk_nrf5340_cpuapp.conf
```kconfig
# nRF7002dk/nRF5340 board specific configuration for all-transports sample

# Disable UART transport - conflicts with console UART
CONFIG_NINEP_TRANSPORT_UART=n

# WiFi support (nRF700X series)
CONFIG_WIFI=y
CONFIG_WIFI_NRF700X=y
CONFIG_NET_L2_WIFI_MGMT=y
CONFIG_NET_L2_WIFI_SHELL=y

# Bluetooth - enable SMP for L2CAP dynamic channels
CONFIG_BT=y
CONFIG_BT_HCI=y
CONFIG_BT_SMP=y
CONFIG_BT_PERIPHERAL=y

# Network shell
CONFIG_NET_SHELL=y

# Nordic-specific heap and stack sizes (increased for 3 servers + WiFi + BT)
CONFIG_HEAP_MEM_POOL_SIZE=131072
CONFIG_MAIN_STACK_SIZE=4096
CONFIG_SYSTEM_WORKQUEUE_STACK_SIZE=2048
```

## boards/nrf7002dk_nrf5340_cpuapp.overlay
```dts
/*
 * Copyright (c) 2025 9p4z Contributors
 * SPDX-License-Identifier: MIT
 *
 * nRF7002dk overlay for all-transports sample
 * Enables WiFi via nRF70 companion chip
 */

/ {
	chosen {
		zephyr,wifi = &wlan0;
	};
};

&wlan0 {
	status = "okay";
};
```

## src/main.c
```c
/*
 * Copyright (c) 2025 9p4z Contributors
 * SPDX-License-Identifier: MIT
 *
 * 9P All Transports Server - Demonstrates all transport types
 * simultaneously serving the same filesystem
 */

#include <zephyr/kernel.h>
#include <zephyr/9p/server.h>
#include <zephyr/9p/sysfs.h>
#ifdef CONFIG_NINEP_TRANSPORT_UART
#include <zephyr/9p/transport_uart.h>
#endif
#ifdef CONFIG_NINEP_TRANSPORT_TCP
#include <zephyr/9p/transport_tcp.h>
#endif
#ifdef CONFIG_NINEP_TRANSPORT_L2CAP
#include <zephyr/9p/transport_l2cap.h>
#include <zephyr/bluetooth/bluetooth.h>
#endif
#include <zephyr/logging/log.h>
#ifdef CONFIG_NINEP_TRANSPORT_TCP
#include <zephyr/net/net_if.h>
#endif
#include <zephyr/device.h>
#ifdef CONFIG_NINEP_TRANSPORT_UART
#include <zephyr/drivers/uart.h>
#endif

LOG_MODULE_REGISTER(main, LOG_LEVEL_INF);

/* Transport instances */
#ifdef CONFIG_NINEP_TRANSPORT_UART
static struct ninep_transport uart_transport;
static struct ninep_server uart_server;
#endif

#ifdef CONFIG_NINEP_TRANSPORT_TCP
static struct ninep_transport tcp_transport;
static struct ninep_server tcp_server;
#endif

#ifdef CONFIG_NINEP_TRANSPORT_L2CAP
static struct ninep_transport l2cap_transport;
static struct ninep_server l2cap_server;
#endif

/* Shared filesystem */
static struct ninep_sysfs sysfs;
static struct ninep_sysfs_entry sysfs_entries[32];

/* RX buffers for each transport */
#ifdef CONFIG_NINEP_TRANSPORT_UART
static uint8_t uart_rx_buf[CONFIG_NINEP_MAX_MESSAGE_SIZE];
#endif

#ifdef CONFIG_NINEP_TRANSPORT_TCP
static uint8_t tcp_rx_buf[CONFIG_NINEP_MAX_MESSAGE_SIZE];
#endif

#ifdef CONFIG_NINEP_TRANSPORT_L2CAP
static uint8_t l2cap_rx_buf[CONFIG_NINEP_MAX_MESSAGE_SIZE];
#endif

#ifdef CONFIG_NINEP_TRANSPORT_L2CAP
/* Bluetooth advertising data */
static const struct bt_data ad[] = {
	BT_DATA_BYTES(BT_DATA_FLAGS, (BT_LE_AD_GENERAL | BT_LE_AD_NO_BREDR)),
	BT_DATA(BT_DATA_NAME_COMPLETE, CONFIG_BT_DEVICE_NAME,
	        sizeof(CONFIG_BT_DEVICE_NAME) - 1),
};
#endif

/* Generator functions for synthetic files */
static int gen_hello(uint8_t *buf, size_t buf_size, uint64_t offset, void *ctx)
{
	const char *msg = "Hello from 9P all transports sample!\n"
	                  "This filesystem is available via:\n"
#ifdef CONFIG_NINEP_TRANSPORT_UART
	                  "- UART\n"
#endif
#ifdef CONFIG_NINEP_TRANSPORT_TCP
	                  "- TCP (port 564)\n"
#endif
#ifdef CONFIG_NINEP_TRANSPORT_L2CAP
	                  "- Bluetooth L2CAP (PSM 0x0009)\n"
#endif
	                  ;
	size_t len = strlen(msg);

	if (offset >= len) {
		return 0;
	}

	size_t to_copy = MIN(len - offset, buf_size);
	memcpy(buf, msg + offset, to_copy);
	return to_copy;
}

static int gen_version(uint8_t *buf, size_t buf_size, uint64_t offset, void *ctx)
{
	char version[256];
	int len = snprintf(version, sizeof(version),
	                  "9p4z All Transports Server\n"
	                  "===========================\n"
	                  "Zephyr: %s\n"
	                  "Build: %s %s\n\n"
	                  "Active Transports:\n"
#ifdef CONFIG_NINEP_TRANSPORT_UART
	                  "- UART: %s\n"
#endif
#ifdef CONFIG_NINEP_TRANSPORT_TCP
	                  "- TCP: port 564\n"
#endif
#ifdef CONFIG_NINEP_TRANSPORT_L2CAP
	                  "- L2CAP: PSM 0x%04x\n"
#endif
	                  ,
	                  "9p4z", __DATE__, __TIME__
#ifdef CONFIG_NINEP_TRANSPORT_UART
	                  , DEVICE_DT_NAME(DT_CHOSEN(zephyr_console))
#endif
#ifdef CONFIG_NINEP_TRANSPORT_L2CAP
	                  , CONFIG_NINEP_L2CAP_PSM
#endif
	                  );

	if (offset >= len) {
		return 0;
	}

	size_t to_copy = MIN(len - offset, buf_size);
	memcpy(buf, version + offset, to_copy);
	return to_copy;
}

static int gen_uptime(uint8_t *buf, size_t buf_size, uint64_t offset, void *ctx)
{
	uint64_t uptime_ms = k_uptime_get();
	uint64_t uptime_sec = uptime_ms / 1000;
	uint64_t hours = uptime_sec / 3600;
	uint64_t minutes = (uptime_sec % 3600) / 60;
	uint64_t seconds = uptime_sec % 60;

	char uptime_str[64];
	int len = snprintf(uptime_str, sizeof(uptime_str),
	                  "%llu:%02llu:%02llu (%llu ms)\n",
	                  hours, minutes, seconds, uptime_ms);

	if (offset >= len) {
		return 0;
	}

	size_t to_copy = MIN(len - offset, buf_size);
	memcpy(buf, uptime_str + offset, to_copy);
	return to_copy;
}

/* Setup shared filesystem */
static int setup_filesystem(void)
{
	int ret;

	/* Initialize sysfs */
	ret = ninep_sysfs_init(&sysfs, sysfs_entries, ARRAY_SIZE(sysfs_entries));
	if (ret < 0) {
		LOG_ERR("Failed to initialize sysfs: %d", ret);
		return ret;
	}

	/* Create /hello.txt */
	ret = ninep_sysfs_register_file(&sysfs, "hello.txt", gen_hello, NULL);
	if (ret < 0) {
		LOG_ERR("Failed to add hello.txt: %d", ret);
		return ret;
	}

	/* Create /sys directory */
	ret = ninep_sysfs_register_dir(&sysfs, "sys");
	if (ret < 0) {
		LOG_ERR("Failed to add sys directory: %d", ret);
		return ret;
	}

	/* Create /sys/version */
	ret = ninep_sysfs_register_file(&sysfs, "sys/version", gen_version, NULL);
	if (ret < 0) {
		LOG_ERR("Failed to add sys/version: %d", ret);
		return ret;
	}

	/* Create /sys/uptime */
	ret = ninep_sysfs_register_file(&sysfs, "sys/uptime", gen_uptime, NULL);
	if (ret < 0) {
		LOG_ERR("Failed to add sys/uptime: %d", ret);
		return ret;
	}

	/* Create /docs directory */
	ret = ninep_sysfs_register_dir(&sysfs, "docs");
	if (ret < 0) {
		LOG_ERR("Failed to add docs directory: %d", ret);
		return ret;
	}

	LOG_INF("Filesystem setup complete");
	return 0;
}

#ifdef CONFIG_NINEP_TRANSPORT_UART
/* Initialize UART transport and server */
static int init_uart_server(void)
{
	int ret;

	const struct device *uart_dev = DEVICE_DT_GET(DT_CHOSEN(zephyr_console));
	if (!device_is_ready(uart_dev)) {
		LOG_ERR("UART device not ready");
		return -ENODEV;
	}

	struct ninep_transport_uart_config uart_config = {
		.uart_dev = uart_dev,
		.rx_buf = uart_rx_buf,
		.rx_buf_size = sizeof(uart_rx_buf),
	};

	ret = ninep_transport_uart_init(&uart_transport, &uart_config, NULL, NULL);
	if (ret < 0) {
		LOG_ERR("Failed to initialize UART transport: %d", ret);
		return ret;
	}

	struct ninep_server_config server_config = {
		.fs_ops = ninep_sysfs_get_ops(),
		.fs_ctx = &sysfs,
		.max_message_size = CONFIG_NINEP_MAX_MESSAGE_SIZE,
		.version = "9P2000",
	};

	ret = ninep_server_init(&uart_server, &server_config, &uart_transport);
	if (ret < 0) {
		LOG_ERR("Failed to initialize UART server: %d", ret);
		return ret;
	}

	ret = ninep_server_start(&uart_server);
	if (ret < 0) {
		LOG_ERR("Failed to start UART server: %d", ret);
		return ret;
	}

	LOG_INF("UART transport initialized on %s", uart_dev->name);
	return 0;
}
#endif /* CONFIG_NINEP_TRANSPORT_UART */

#ifdef CONFIG_NINEP_TRANSPORT_TCP
/* Initialize TCP transport and server */
static int init_tcp_server(void)
{
	int ret;

	struct ninep_tcp_config tcp_config = {
		.port = 564,
		.rx_buf_size = sizeof(tcp_rx_buf),
	};

	ret = ninep_tcp_transport_init(&tcp_transport, &tcp_config, NULL, NULL);
	if (ret < 0) {
		LOG_ERR("Failed to initialize TCP transport: %d", ret);
		return ret;
	}

	struct ninep_server_config server_config = {
		.fs_ops = ninep_sysfs_get_ops(),
		.fs_ctx = &sysfs,
		.max_message_size = CONFIG_NINEP_MAX_MESSAGE_SIZE,
		.version = "9P2000",
	};

	ret = ninep_server_init(&tcp_server, &server_config, &tcp_transport);
	if (ret < 0) {
		LOG_ERR("Failed to initialize TCP server: %d", ret);
		return ret;
	}

	ret = ninep_server_start(&tcp_server);
	if (ret < 0) {
		LOG_ERR("Failed to start TCP server: %d", ret);
		return ret;
	}

	LOG_INF("TCP transport initialized on port 564");
	return 0;
}
#endif /* CONFIG_NINEP_TRANSPORT_TCP */

#ifdef CONFIG_NINEP_TRANSPORT_L2CAP
/* Initialize L2CAP transport and server */
static int init_l2cap_server(void)
{
	int ret;

	/* Initialize Bluetooth */
	ret = bt_enable(NULL);
	if (ret) {
		LOG_ERR("Bluetooth init failed (err %d)", ret);
		return ret;
	}

	LOG_INF("Bluetooth initialized");

	/* Start advertising */
	ret = bt_le_adv_start(BT_LE_ADV_CONN, ad, ARRAY_SIZE(ad), NULL, 0);
	if (ret) {
		LOG_ERR("Advertising failed to start (err %d)", ret);
		return ret;
	}

	LOG_INF("Bluetooth advertising started");

	struct ninep_transport_l2cap_config l2cap_config = {
		.psm = CONFIG_NINEP_L2CAP_PSM,
		.rx_buf = l2cap_rx_buf,
		.rx_buf_size = sizeof(l2cap_rx_buf),
	};

	ret = ninep_transport_l2cap_init(&l2cap_transport, &l2cap_config, NULL, NULL);
	if (ret < 0) {
		LOG_ERR("Failed to initialize L2CAP transport: %d", ret);
		return ret;
	}

	struct ninep_server_config server_config = {
		.fs_ops = ninep_sysfs_get_ops(),
		.fs_ctx = &sysfs,
		.max_message_size = CONFIG_NINEP_MAX_MESSAGE_SIZE,
		.version = "9P2000",
	};

	ret = ninep_server_init(&l2cap_server, &server_config, &l2cap_transport);
	if (ret < 0) {
		LOG_ERR("Failed to initialize L2CAP server: %d", ret);
		return ret;
	}

	ret = ninep_server_start(&l2cap_server);
	if (ret < 0) {
		LOG_ERR("Failed to start L2CAP server: %d", ret);
		return ret;
	}

	LOG_INF("L2CAP transport initialized on PSM 0x%04x", CONFIG_NINEP_L2CAP_PSM);
	return 0;
}
#endif /* CONFIG_NINEP_TRANSPORT_L2CAP */

int main(void)
{
	int ret;

	printk("\n\n*** 9P All Transports Server Starting ***\n");

	LOG_INF("===========================================");
	LOG_INF("9P All Transports Server");
	LOG_INF("===========================================");

	/* Setup shared filesystem */
	ret = setup_filesystem();
	if (ret < 0) {
		LOG_ERR("Failed to setup filesystem: %d", ret);
		return 0;
	}

	/* Initialize all transports */
	LOG_INF("Initializing transports...");

#ifdef CONFIG_NINEP_TRANSPORT_UART
	ret = init_uart_server();
	if (ret < 0) {
		LOG_WRN("UART transport not available (continuing without it)");
	}
#endif

#ifdef CONFIG_NINEP_TRANSPORT_TCP
	ret = init_tcp_server();
	if (ret < 0) {
		LOG_WRN("TCP transport not available (continuing without it)");
	}
#endif

#ifdef CONFIG_NINEP_TRANSPORT_L2CAP
	ret = init_l2cap_server();
	if (ret < 0) {
		LOG_WRN("L2CAP transport not available (continuing without it)");
	}
#endif

	LOG_INF("===========================================");
	LOG_INF("Server ready!");
	LOG_INF("===========================================");
#ifdef CONFIG_NINEP_TRANSPORT_UART
	LOG_INF("UART:  Connect via serial console");
#endif
#ifdef CONFIG_NINEP_TRANSPORT_TCP
	LOG_INF("TCP:   9p -a tcp!<IP>!564 ls /");
#endif
#ifdef CONFIG_NINEP_TRANSPORT_L2CAP
	LOG_INF("L2CAP: Use iOS 9p4i app, PSM 0x%04x", CONFIG_NINEP_L2CAP_PSM);
#endif
	LOG_INF("===========================================");

	printk("Server running - shell available\n");

	/* All servers run in background via transport callbacks */
	/* Keep main thread alive for shell and logging */
	while (1) {
		k_sleep(K_SECONDS(60));
	}

	return 0;
}
```
