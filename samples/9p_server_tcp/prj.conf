## CMakeLists.txt
```
# Copyright (c) 2025 9p4z Contributors
# SPDX-License-Identifier: MIT

cmake_minimum_required(VERSION 3.20.0)

find_package(Zephyr REQUIRED HINTS $ENV{ZEPHYR_BASE})
project(9p_server_tcp)

target_sources(app PRIVATE src/main.c)
```

## sysbuild.conf
```
# Sysbuild configuration for nRF7002 WiFi support
SB_CONFIG_WIFI_NRF70=y
```

## prj.conf
```kconfig
# 9P TCP Server Sample Configuration

# Enable 9P support
CONFIG_NINEP=y
CONFIG_NINEP_CLIENT=n
CONFIG_NINEP_SERVER=y
CONFIG_NINEP_TRANSPORT_TCP=y

# Message and resource limits
CONFIG_NINEP_MAX_MESSAGE_SIZE=8192
CONFIG_NINEP_MAX_FIDS=32
CONFIG_NINEP_MAX_TAGS=16

# Logging and console
CONFIG_LOG=y
CONFIG_NINEP_LOG_LEVEL_DBG=y

# Heap for dynamic allocation
CONFIG_HEAP_MEM_POOL_SIZE=16384

# Networking (dual-stack: IPv4 + IPv6)
CONFIG_NETWORKING=y
CONFIG_NET_L2_ETHERNET=y
CONFIG_NET_IPV4=y
CONFIG_NET_IPV6=y
CONFIG_NET_TCP=y
CONFIG_NET_SOCKETS=y
CONFIG_NET_QEMU_ETHERNET=y
CONFIG_ETH_E1000=y
CONFIG_PCIE=y

# Network stack sizing
CONFIG_NET_PKT_RX_COUNT=16
CONFIG_NET_PKT_TX_COUNT=16
CONFIG_NET_BUF_RX_COUNT=16
CONFIG_NET_BUF_TX_COUNT=16
CONFIG_NET_CONTEXT_NET_PKT_POOL=y

# IP addressing (DHCP disabled, static config)
CONFIG_NET_DHCPV4=n
CONFIG_NET_DHCPV6=n
CONFIG_NET_CONFIG_SETTINGS=y

# IPv4 address
CONFIG_NET_CONFIG_NEED_IPV4=y
CONFIG_NET_CONFIG_MY_IPV4_ADDR="192.0.2.1"
CONFIG_NET_CONFIG_MY_IPV4_NETMASK="255.255.255.0"

# IPv6 address
CONFIG_NET_CONFIG_NEED_IPV6=y
CONFIG_NET_CONFIG_MY_IPV6_ADDR="2001:db8::1"

# Shell disabled for TCP server (not needed)
# CONFIG_SHELL=y
# CONFIG_SHELL_BACKEND_SERIAL=y
```

## prj_nrf.conf
```kconfig
# 9P TCP Server Sample Configuration for nRF boards
# Use: west build -b nrf5340dk/nrf5340/cpuapp -DCONF_FILE=prj_nrf.conf

# Enable 9P support
CONFIG_NINEP=y
CONFIG_NINEP_CLIENT=n
CONFIG_NINEP_SERVER=y
CONFIG_NINEP_TRANSPORT_TCP=y

# Message and resource limits
CONFIG_NINEP_MAX_MESSAGE_SIZE=8192
CONFIG_NINEP_MAX_FIDS=32
CONFIG_NINEP_MAX_TAGS=16

# Logging and console
CONFIG_LOG=y
CONFIG_NINEP_LOG_LEVEL_DBG=y

# Shell for WiFi configuration
CONFIG_SHELL=y
CONFIG_SHELL_BACKEND_SERIAL=y
CONFIG_SHELL_STACK_SIZE=5400
CONFIG_NET_SHELL=y
CONFIG_DNS_RESOLVER=y

# Heap for dynamic allocation (WiFi needs more)
CONFIG_HEAP_MEM_POOL_SIZE=41808
CONFIG_NRF_WIFI_CTRL_HEAP_SIZE=20000
CONFIG_NRF_WIFI_DATA_HEAP_SIZE=168192

# Stack sizes for network threads
CONFIG_MAIN_STACK_SIZE=5200
CONFIG_NET_TX_STACK_SIZE=4096
CONFIG_NET_RX_STACK_SIZE=4096

# Networking - native stack with WiFi (like nRF WiFi samples)
CONFIG_NETWORKING=y
CONFIG_NET_L2_ETHERNET=y
CONFIG_NET_IPV4=y
CONFIG_NET_TCP=y
CONFIG_NET_SOCKETS=y
CONFIG_NET_LOG=y

# WiFi support (requires nRF7002)
CONFIG_WIFI=y
CONFIG_WIFI_NRF70=y
CONFIG_NET_L2_WIFI_MGMT=y
CONFIG_WIFI_NM_WPA_SUPPLICANT=y
CONFIG_NET_L2_WIFI_SHELL=y
CONFIG_NRF_WIFI_LOW_POWER=n

# Note: WiFi credentials persistence disabled to avoid partition conflicts
# Use shell to connect: wifi connect -s "SSID" -k 3 -p "password"

# Network stack sizing (tuned for WiFi)
CONFIG_NET_PKT_RX_COUNT=60
CONFIG_NET_PKT_TX_COUNT=6
CONFIG_NET_BUF_RX_COUNT=60
CONFIG_NET_BUF_TX_COUNT=12
CONFIG_NET_CONTEXT_NET_PKT_POOL=y
CONFIG_NET_TC_TX_COUNT=1

# IP addressing - use DHCP
CONFIG_NET_CONFIG_SETTINGS=y
CONFIG_NET_CONFIG_NEED_IPV4=y
CONFIG_NET_DHCPV4=y
CONFIG_NET_CONFIG_MY_IPV4_ADDR=""
CONFIG_NET_CONFIG_MY_IPV4_NETMASK=""

# Build output for flashing to hardware
CONFIG_BUILD_OUTPUT_HEX=y
```

## boards/esp32s3_devkitc_esp32s3_procpu.conf
```kconfig
# ESP32-S3 DevKitC board specific configuration

# Disable qemu-specific drivers but keep Ethernet L2 layer (needed by WiFi)
CONFIG_NET_L2_ETHERNET=y
CONFIG_NET_QEMU_ETHERNET=n
CONFIG_ETH_E1000=n
CONFIG_PCIE=n

# Shell support
CONFIG_SHELL=y
CONFIG_SHELL_BACKEND_SERIAL=y
CONFIG_SHELL_PROMPT_UART="esp32s3:~$ "
CONFIG_KERNEL_SHELL=y

# WiFi support (matching official Zephyr WiFi sample)
CONFIG_WIFI=y
CONFIG_NET_L2_WIFI_MGMT=y
CONFIG_NET_L2_WIFI_SHELL=y
CONFIG_ESP32_WIFI_STA_AUTO_DHCPV4=y

# Network shell
CONFIG_NET_SHELL=y

# ESP32-S3 specific
CONFIG_ESPTOOLPY_FLASHSIZE_4MB=y
CONFIG_MAIN_STACK_SIZE=4096
CONFIG_SYSTEM_WORKQUEUE_STACK_SIZE=2048

# Reduce memory footprint for ESP32
CONFIG_NINEP_MAX_MESSAGE_SIZE=4096
CONFIG_NINEP_MAX_FIDS=16
CONFIG_NINEP_MAX_TAGS=8
CONFIG_HEAP_MEM_POOL_SIZE=32768

# Network stack sizing for ESP32
CONFIG_NET_PKT_RX_COUNT=8
CONFIG_NET_PKT_TX_COUNT=8
CONFIG_NET_BUF_RX_COUNT=8
CONFIG_NET_BUF_TX_COUNT=8
```

## boards/nrf5340dk_nrf5340_cpuapp.conf
```kconfig
# nRF5340 DK WiFi Configuration (for use with nRF7002 shield)

# Disable QEMU-specific networking (from base prj.conf)
CONFIG_NET_QEMU_ETHERNET=n
CONFIG_ETH_E1000=n
CONFIG_PCIE=n

# Override L2 to match real hardware capabilities
CONFIG_NET_L2_ETHERNET=n

# WiFi configuration for nRF7002 shield
# Note: Requires nrf7002ek shield overlay
# Build with: west build -b nrf5340dk_nrf5340_cpuapp -- -DSHIELD=nrf7002ek

# Network stack already enabled in prj.conf
# TCP and sockets already enabled in prj.conf

# IP addressing - use DHCP for WiFi
CONFIG_NET_DHCPV4=y
CONFIG_NET_CONFIG_MY_IPV4_ADDR=""
CONFIG_NET_CONFIG_MY_IPV4_NETMASK=""

# Build output for flashing to hardware
CONFIG_BUILD_OUTPUT_HEX=y
```

## boards/nrf7002dk_nrf5340_cpuapp.conf
```kconfig
# nRF7002dk/nRF5340 board specific configuration

# WiFi support
CONFIG_WIFI=y
CONFIG_WIFI_NRF700X=y
CONFIG_NET_L2_WIFI_MGMT=y
CONFIG_NET_L2_WIFI_SHELL=y

# Network shell
CONFIG_NET_SHELL=y

# Nordic-specific
CONFIG_HEAP_MEM_POOL_SIZE=131072
CONFIG_MAIN_STACK_SIZE=4096
CONFIG_SYSTEM_WORKQUEUE_STACK_SIZE=2048
```

## boards/esp32s3_devkitc_esp32s3_procpu.overlay
```dts
/* Enable WiFi for ESP32-S3 DevKitC */

&wifi {
	status = "okay";
};
```

## src/main.c
```c
/*
 * Copyright (c) 2025 9p4z Contributors
 * SPDX-License-Identifier: MIT
 *
 * 9P TCP Server - Serves a synthetic filesystem over TCP/IP
 *
 * Operates in dual-stack mode (IPv4 + IPv6) when CONFIG_NET_IPV6 is enabled.
 * Accepts both native IPv6 connections and IPv4-mapped IPv6 connections.
 */

#include <zephyr/kernel.h>
#include <zephyr/9p/server.h>
#include <zephyr/9p/sysfs.h>
#include <zephyr/9p/transport_tcp.h>
#include <zephyr/logging/log.h>
#include <zephyr/net/net_if.h>
#include <zephyr/net/net_core.h>
#include <zephyr/net/net_context.h>
#include <zephyr/net/net_mgmt.h>
#include <zephyr/net/wifi_mgmt.h>

LOG_MODULE_REGISTER(main, LOG_LEVEL_INF);

static struct ninep_transport g_transport;
static struct ninep_server g_server;
static struct ninep_sysfs g_sysfs;
static struct ninep_sysfs_entry g_sysfs_entries[32];
static struct ninep_tcp_config tcp_config;
static struct ninep_server_config server_config;

/* Static content for demo files */
static const char *hello_content = "Hello from Zephyr 9P TCP server!\n";
static const char *readme_content =
	"9P Server on Zephyr RTOS over TCP/IP (Dual-Stack)\n"
	"===================================================\n\n"
	"This is a demonstration 9P server running on Zephyr.\n"
	"It serves both static demo files and dynamic system info.\n\n"
	"Connection:\n"
	"  Port:    564 (standard 9P port)\n"
	"  Mode:    Dual-stack (IPv4 + IPv6)\n\n"
	"Demo Files:\n"
	"  /hello.txt  - Static greeting\n"
	"  /readme.txt - This file\n"
	"  /docs/*     - Demo documents\n\n"
	"System Info (dynamic):\n"
	"  /sys/uptime  - System uptime\n"
	"  /sys/version - Kernel version\n"
	"  /sys/board   - Board name\n\n"
	"Network Info:\n"
	"  /net/interfaces - Network interface details\n"
	"  /net/stats      - Network statistics\n\n"
	"WiFi Info (on supported hardware):\n"
	"  /wifi/status    - WiFi connection status\n"
	"  /wifi/rssi      - Signal strength\n\n"
	"Try (IPv4):\n"
	"  9p -a tcp!192.0.2.1!564 ls /\n"
	"  9p -a tcp!192.0.2.1!564 read /sys/uptime\n\n"
	"Try (IPv6):\n"
	"  9p -a tcp![2001:db8::1]!564 ls /\n"
	"  9p -a tcp![2001:db8::1]!564 read /net/interfaces\n";
static const char *doc1_content = "This is document 1\n";
static const char *doc2_content = "This is document 2\n";

/* Generator for static content (allows reuse of const strings) */
static int gen_static(uint8_t *buf, size_t buf_size,
                      uint64_t offset, void *ctx)
{
	const char *content = (const char *)ctx;
	size_t len = strlen(content);

	if (offset >= len) {
		return 0;
	}

	size_t to_copy = len - offset;
	if (to_copy > buf_size) {
		to_copy = buf_size;
	}

	memcpy(buf, content + offset, to_copy);
	return to_copy;
}

/* Generator for /sys/uptime */
static int gen_sys_uptime(uint8_t *buf, size_t buf_size,
                          uint64_t offset, void *ctx)
{
	ARG_UNUSED(ctx);

	if (offset > 0) {
		return 0;  /* Single-read file */
	}

	int64_t uptime_ms = k_uptime_get();
	int uptime_sec = uptime_ms / 1000;
	int uptime_min = uptime_sec / 60;
	int uptime_hr = uptime_min / 60;
	int uptime_days = uptime_hr / 24;

	int len = snprintf((char *)buf, buf_size,
	                   "%d days, %d hours, %d minutes, %d seconds (%lld ms)\n",
	                   uptime_days,
	                   uptime_hr % 24,
	                   uptime_min % 60,
	                   uptime_sec % 60,
	                   uptime_ms);

	return len;
}

/* Generator for /sys/version */
static int gen_sys_version(uint8_t *buf, size_t buf_size,
                           uint64_t offset, void *ctx)
{
	ARG_UNUSED(ctx);

	if (offset > 0) {
		return 0;
	}

	uint32_t version = sys_kernel_version_get();
	int len = snprintf((char *)buf, buf_size,
	                   "Zephyr %d.%d.%d\n9P4Z TCP Server\n",
	                   SYS_KERNEL_VER_MAJOR(version),
	                   SYS_KERNEL_VER_MINOR(version),
	                   SYS_KERNEL_VER_PATCHLEVEL(version));

	return len;
}

/* Generator for /sys/board */
static int gen_sys_board(uint8_t *buf, size_t buf_size,
                         uint64_t offset, void *ctx)
{
	ARG_UNUSED(ctx);

	if (offset > 0) {
		return 0;
	}

	int len = snprintf((char *)buf, buf_size, "%s\n", CONFIG_BOARD);

	return len;
}

/* Generator for /net/interfaces */
static int gen_net_interfaces(uint8_t *buf, size_t buf_size,
                               uint64_t offset, void *ctx)
{
	ARG_UNUSED(ctx);

	if (offset > 0) {
		return 0;
	}

	size_t len = 0;
	struct net_if *iface;

	/* Iterate through all network interfaces */
	STRUCT_SECTION_FOREACH(net_if, iface) {
		char addr_str[NET_IPV4_ADDR_LEN];
		const char *status;

		/* Interface name and index */
		len += snprintf((char *)buf + len, buf_size - len,
		                "Interface %d: %p\n", net_if_get_by_iface(iface), iface);

		if (len >= buf_size) break;

		/* Link address (MAC) */
		struct net_linkaddr *link_addr = net_if_get_link_addr(iface);
		if (link_addr && link_addr->len > 0) {
			len += snprintf((char *)buf + len, buf_size - len, "  MAC: ");
			if (len >= buf_size) break;

			for (int i = 0; i < link_addr->len; i++) {
				len += snprintf((char *)buf + len, buf_size - len,
				                "%02x%s", link_addr->addr[i],
				                i < link_addr->len - 1 ? ":" : "");
				if (len >= buf_size) break;
			}
			len += snprintf((char *)buf + len, buf_size - len, "\n");
			if (len >= buf_size) break;
		}

		/* Interface status */
		if (net_if_is_up(iface)) {
			status = "UP";
		} else {
			status = "DOWN";
		}
		len += snprintf((char *)buf + len, buf_size - len, "  Status: %s\n", status);
		if (len >= buf_size) break;

		/* IPv4 addresses */
		struct net_if_ipv4 *ipv4 = iface->config.ip.ipv4;
		if (ipv4) {
			for (int i = 0; i < NET_IF_MAX_IPV4_ADDR; i++) {
				if (ipv4->unicast[i].ipv4.addr_state != NET_ADDR_ANY_STATE) {
					net_addr_ntop(AF_INET,
					              &ipv4->unicast[i].ipv4.address.in_addr,
					              addr_str, sizeof(addr_str));
					len += snprintf((char *)buf + len, buf_size - len,
					                "  IPv4: %s\n", addr_str);
					if (len >= buf_size) break;
				}
			}
		}

		len += snprintf((char *)buf + len, buf_size - len, "\n");
		if (len >= buf_size) break;
	}

	return len;
}

/* Generator for /net/stats */
static int gen_net_stats(uint8_t *buf, size_t buf_size,
                         uint64_t offset, void *ctx)
{
	ARG_UNUSED(ctx);

	if (offset > 0) {
		return 0;
	}

#if defined(CONFIG_NET_STATISTICS)
	struct net_stats stats;
	net_mgmt(NET_REQUEST_STATS_GET_ALL, NULL, &stats, sizeof(stats));

	size_t len = snprintf((char *)buf, buf_size,
	                      "Network Statistics:\n"
	                      "  TX: %llu bytes, %llu packets\n"
	                      "  RX: %llu bytes, %llu packets\n"
	                      "  Errors: %llu\n",
	                      (unsigned long long)stats.bytes.sent,
	                      (unsigned long long)stats.pkts.tx,
	                      (unsigned long long)stats.bytes.received,
	                      (unsigned long long)stats.pkts.rx,
	                      (unsigned long long)stats.processing_error);
	return len;
#else
	return snprintf((char *)buf, buf_size, "Network statistics not available\n");
#endif
}

/* Generator for /wifi/status */
static int gen_wifi_status(uint8_t *buf, size_t buf_size,
                           uint64_t offset, void *ctx)
{
	ARG_UNUSED(ctx);

	if (offset > 0) {
		return 0;
	}

	struct net_if *iface = net_if_get_default();
	if (!iface) {
		return snprintf((char *)buf, buf_size, "No network interface\n");
	}

	/* Allocate status struct from heap to avoid stack overflow */
	struct wifi_iface_status *status = k_malloc(sizeof(struct wifi_iface_status));
	if (!status) {
		return snprintf((char *)buf, buf_size, "Error: Out of memory\n");
	}

	memset(status, 0, sizeof(*status));
	int ret = net_mgmt(NET_REQUEST_WIFI_IFACE_STATUS, iface,
	                   status, sizeof(*status));

	if (ret < 0) {
		k_free(status);
		return snprintf((char *)buf, buf_size, "WiFi status unavailable (error %d)\n", ret);
	}

	const char *state_str;
	switch (status->state) {
	case WIFI_STATE_DISCONNECTED:
		state_str = "DISCONNECTED";
		break;
	case WIFI_STATE_INTERFACE_DISABLED:
		state_str = "DISABLED";
		break;
	case WIFI_STATE_SCANNING:
		state_str = "SCANNING";
		break;
	case WIFI_STATE_AUTHENTICATING:
		state_str = "AUTHENTICATING";
		break;
	case WIFI_STATE_ASSOCIATING:
		state_str = "ASSOCIATING";
		break;
	case WIFI_STATE_ASSOCIATED:
		state_str = "ASSOCIATED";
		break;
	case WIFI_STATE_4WAY_HANDSHAKE:
		state_str = "4WAY_HANDSHAKE";
		break;
	case WIFI_STATE_GROUP_HANDSHAKE:
		state_str = "GROUP_HANDSHAKE";
		break;
	case WIFI_STATE_COMPLETED:
		state_str = "CONNECTED";
		break;
	default:
		state_str = "UNKNOWN";
		break;
	}

	int len = snprintf((char *)buf, buf_size,
	                   "State: %s\n"
	                   "SSID: %s\n"
	                   "Channel: %d\n"
	                   "Link Mode: %s\n"
	                   "RSSI: %d dBm\n",
	                   state_str,
	                   status->ssid,
	                   status->channel,
	                   status->link_mode == WIFI_LINK_MODE_UNKNOWN ? "UNKNOWN" :
	                   status->link_mode == WIFI_1 ? "802.11b" :
	                   status->link_mode == WIFI_2 ? "802.11a" :
	                   status->link_mode == WIFI_3 ? "802.11g" :
	                   status->link_mode == WIFI_4 ? "802.11n" :
	                   status->link_mode == WIFI_5 ? "802.11ac" :
	                   status->link_mode == WIFI_6 ? "802.11ax" : "OTHER",
	                   status->rssi);

	k_free(status);
	return len;
}

/* Generator for /wifi/rssi */
static int gen_wifi_rssi(uint8_t *buf, size_t buf_size,
                         uint64_t offset, void *ctx)
{
	ARG_UNUSED(ctx);

	if (offset > 0) {
		return 0;
	}

	struct net_if *iface = net_if_get_default();
	if (!iface) {
		return snprintf((char *)buf, buf_size, "N/A\n");
	}

	/* Allocate status struct from heap to avoid stack overflow */
	struct wifi_iface_status *status = k_malloc(sizeof(struct wifi_iface_status));
	if (!status) {
		return snprintf((char *)buf, buf_size, "Error: Out of memory\n");
	}

	memset(status, 0, sizeof(*status));
	int ret = net_mgmt(NET_REQUEST_WIFI_IFACE_STATUS, iface,
	                   status, sizeof(*status));

	if (ret < 0) {
		k_free(status);
		return snprintf((char *)buf, buf_size, "N/A\n");
	}

	int len = snprintf((char *)buf, buf_size, "%d dBm\n", status->rssi);
	k_free(status);
	return len;
}

static void setup_demo_filesystem(void)
{
	int ret;

	/* Initialize sysfs */
	ret = ninep_sysfs_init(&g_sysfs, g_sysfs_entries,
	                        ARRAY_SIZE(g_sysfs_entries));
	if (ret < 0) {
		LOG_ERR("Failed to initialize sysfs: %d", ret);
		return;
	}

	/* Register demo files */
	ninep_sysfs_register_file(&g_sysfs, "/hello.txt", gen_static,
	                           (void *)hello_content);
	ninep_sysfs_register_file(&g_sysfs, "/readme.txt", gen_static,
	                           (void *)readme_content);

	/* Register docs directory and files */
	ninep_sysfs_register_dir(&g_sysfs, "/docs");
	ninep_sysfs_register_file(&g_sysfs, "/docs/doc1.txt", gen_static,
	                           (void *)doc1_content);
	ninep_sysfs_register_file(&g_sysfs, "/docs/doc2.txt", gen_static,
	                           (void *)doc2_content);

	/* Register /sys directory */
	ninep_sysfs_register_dir(&g_sysfs, "/sys");

	/* Register system information files */
	ninep_sysfs_register_file(&g_sysfs, "/sys/uptime", gen_sys_uptime, NULL);
	ninep_sysfs_register_file(&g_sysfs, "/sys/version", gen_sys_version, NULL);
	ninep_sysfs_register_file(&g_sysfs, "/sys/board", gen_sys_board, NULL);

	/* Register /net directory */
	ninep_sysfs_register_dir(&g_sysfs, "/net");

	/* Register network information files */
	ninep_sysfs_register_file(&g_sysfs, "/net/interfaces", gen_net_interfaces, NULL);
	ninep_sysfs_register_file(&g_sysfs, "/net/stats", gen_net_stats, NULL);

	/* Register /wifi directory */
	ninep_sysfs_register_dir(&g_sysfs, "/wifi");

	/* Register WiFi information files */
	ninep_sysfs_register_file(&g_sysfs, "/wifi/status", gen_wifi_status, NULL);
	ninep_sysfs_register_file(&g_sysfs, "/wifi/rssi", gen_wifi_rssi, NULL);

	LOG_INF("Filesystem initialized");
	LOG_INF("Demo files:");
	LOG_INF("  /hello.txt");
	LOG_INF("  /readme.txt");
	LOG_INF("  /docs/doc1.txt");
	LOG_INF("  /docs/doc2.txt");
	LOG_INF("System info:");
	LOG_INF("  /sys/uptime   - system uptime");
	LOG_INF("  /sys/version  - kernel version");
	LOG_INF("  /sys/board    - board name");
	LOG_INF("Network info:");
	LOG_INF("  /net/interfaces - network interface details");
	LOG_INF("  /net/stats      - network statistics");
	LOG_INF("WiFi info:");
	LOG_INF("  /wifi/status    - WiFi connection status");
	LOG_INF("  /wifi/rssi      - signal strength");
}

static void print_network_info(void)
{
	struct net_if *iface = net_if_get_default();

	if (!iface) {
		LOG_ERR("No network interface available");
		return;
	}

	LOG_INF("Network interface: %p", iface);

	/* Print IPv4 addresses */
	struct net_if_ipv4 *ipv4 = iface->config.ip.ipv4;

	if (ipv4) {
		for (int i = 0; i < NET_IF_MAX_IPV4_ADDR; i++) {
			if (ipv4->unicast[i].ipv4.addr_state != NET_ADDR_ANY_STATE) {
				char addr_str[NET_IPV4_ADDR_LEN];

				net_addr_ntop(AF_INET,
				              &ipv4->unicast[i].ipv4.address.in_addr,
				              addr_str, sizeof(addr_str));
				LOG_INF("  IPv4 address: %s", addr_str);
			}
		}
	}
}

int main(void)
{
	int ret;

	LOG_INF("=== 9P TCP Server ===");

	/* Wait a bit for network to come up */
	k_sleep(K_SECONDS(1));

	print_network_info();

	/* Setup sysfs */
	setup_demo_filesystem();

	/* Configure TCP transport */
	tcp_config.port = 564;  /* Standard 9P port */
	tcp_config.rx_buf_size = CONFIG_NINEP_MAX_MESSAGE_SIZE;

	/* Initialize transport */
	ret = ninep_tcp_transport_init(&g_transport, &tcp_config, NULL, NULL);
	if (ret < 0) {
		LOG_ERR("Failed to initialize TCP transport: %d", ret);
		return -1;
	}

	/* Configure server */
	server_config.fs_ops = ninep_sysfs_get_ops();
	server_config.fs_ctx = &g_sysfs;
	server_config.max_message_size = CONFIG_NINEP_MAX_MESSAGE_SIZE;
	server_config.version = "9P2000";

	/* Initialize server */
	ret = ninep_server_init(&g_server, &server_config, &g_transport);
	if (ret < 0) {
		LOG_ERR("Failed to initialize server: %d", ret);
		return -1;
	}

	/* Start server */
	ret = ninep_server_start(&g_server);
	if (ret < 0) {
		LOG_ERR("Failed to start server: %d", ret);
		return -1;
	}

	LOG_INF("9P server ready - dual-stack TCP transport");
	LOG_INF("  IPv4: 9p -a tcp!192.0.2.1!564 ls /");
	LOG_INF("  IPv6: 9p -a tcp![2001:db8::1]!564 ls /");

	/* Server runs in background via transport callbacks.
	 * Shell runs automatically on console.
	 * Just return and let the system run.
	 */
	return 0;
}
```
